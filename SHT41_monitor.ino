/*
 * SHT41 온습도 모니터  v1.14 (현황/이력 저장 분리, 보드3대 등록)
 *  - 현황(env_current): 1분마다 upsert(덮어쓰기) → 대시보드 실시간
 *  - 이력(env_log): 1시간마다 insert → 통계/CSV, 30일 보관
 *  - T-Display(세로) 한글표시(온도/습도) : RGB565 pushImage 방식 (XBM 미사용)
 *  - MAC 기반 자동 식별(SHT41_n / 구역)
 *  - 통신을 2번 코어로 분리 -> 화면 지연 없음, 부팅 즉시 측정값 표시
 *  - Supabase env_log 전송
 *  I2C: SDA=21, SCL=22  /  화면: setRotation(0)
 *
 *  [새 보드 등록]
 *   1) 굽기 -> 시리얼모니터(115200)의  MAC: xx:xx:..  확인
 *   2) REGISTRY 에  {"그MAC","SHT41_n","구역코드"}  한 줄 추가
 *   3) 그 보드만 다시 굽기
 */
#include <Wire.h>
#include "Adafruit_SHT4x.h"
#include <TFT_eSPI.h>
#include <WiFi.h>
#include <WiFiMulti.h>
#include <WiFiClientSecure.h>
#include <HTTPClient.h>
#include <time.h>
#include "esp_mac.h"   // MAC을 efuse에서 직접 읽기 (항상 진짜 값)

#define SHT_SDA 21
#define SHT_SCL 22

// WiFi AP는 netTask()에서 등록 (검사기 카운터와 동일 목록)

const char* SB_REST = "https://omngtyewdaqpphnzeate.supabase.co/rest/v1/";
const char* SB_KEY = "sb_publishable_9j2YkkL-7ul1TrhH-NjVdQ_vWDG2-1D";

const unsigned long LIVE_INTERVAL = 60000;     // 현황(env_current) 1분
const unsigned long HIST_INTERVAL = 3600000;   // 이력(env_log) 1시간
const unsigned long DISP_INTERVAL = 2000;      // 화면 갱신 2초

// 보드 등록표 (MAC -> ID -> 구역코드). 구역코드는 영문/숫자.
struct DevReg { const char* mac; const char* id; const char* zone; };
const DevReg REGISTRY[] = {
  {"5C:01:3B:07:B5:48", "SHT41_1", "B_A"},
  {"5C:01:3B:07:99:28", "SHT41_2", "B_B"},
  {"5C:01:3B:07:9F:4C", "SHT41_3", "B_C"},
  // 새 보드 추가: {"MAC", "SHT41_n", "구역코드"},
};
const int REG_N = sizeof(REGISTRY) / sizeof(REGISTRY[0]);

// ===== 한글 라벨 (RGB565, 흰색 글자) =====
#define LBL_TEMP_W 46
#define LBL_TEMP_H 24
const uint16_t LBL_TEMP[] PROGMEM = { 0x0000, 0x0000, 0x0000, 0x0000, 0x0000, 0x0000, 0x0000, 0x0000, 0x0000, 0x0000, 0x0000, 0x0000, 0x0000,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 0x0000, 0x0000 };

#define LBL_HUMI_W 46
#define LBL_HUMI_H 26
const uint16_t LBL_HUMI[] PROGMEM = { 0x0000, 0x0000, 0x0000, 0x0000, 0x0000, 0x0000, 0x0000, 0x0000, 0x0000, 0x0000, 0x0000, 0x0000, 0x0000,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 0x0000, 0x0000 };

#define LBL_FEEL_W 46
#define LBL_FEEL_H 26
const uint16_t LBL_FEEL[] PROGMEM = { 0x0000, 0x0000, 0x0000, 0x0000, 0x0000, 0x0000, 0x0000, 0x0000, 0x0000, 0x0000, 0x0000, 0x0000, 0x0000,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 0x0000, 0x0000 };


TFT_eSPI tft = TFT_eSPI();
Adafruit_SHT4x sht4 = Adafruit_SHT4x();
WiFiMulti wifiMulti;

String DEVICE_ID = "UNREG";
String ZONE = "";
String MAC = "";
volatile float gTemp = 0, gHumi = 0, gFeel = 0;
volatile bool lastSendOK = false;
unsigned long lastDisp = 0;

void resolveIdentity() {
  uint8_t m[6];
  esp_read_mac(m, ESP_MAC_WIFI_STA);   // efuse에서 직접 (항상 진짜 값)
  char b[18];
  snprintf(b, sizeof(b), "%02X:%02X:%02X:%02X:%02X:%02X",
           m[0], m[1], m[2], m[3], m[4], m[5]);
  MAC = String(b);
  for (int i = 0; i < REG_N; i++) {
    String r = REGISTRY[i].mac; r.toUpperCase();
    if (MAC == r) { DEVICE_ID = REGISTRY[i].id; ZONE = REGISTRY[i].zone; return; }
  }
  String tail = MAC.substring(12); tail.replace(":", "");
  DEVICE_ID = "UNREG-" + tail; ZONE = "";
}

// 체감온도 (NWS 열지수, 섭씨). 실내라 바람 영향은 무시.
float heatIndexC(float Tc, float R) {
  float T = Tc * 1.8 + 32.0;                 // -> 화씨
  float HI;
  if (T < 80.0) {
    HI = 0.5 * (T + 61.0 + (T - 68.0) * 1.2 + R * 0.094);
  } else {
    HI = -42.379 + 2.04901523 * T + 10.14333127 * R
         - 0.22475541 * T * R - 0.00683783 * T * T - 0.05481717 * R * R
         + 0.00122874 * T * T * R + 0.00085282 * T * R * R - 0.00000199 * T * T * R * R;
    if (R < 13 && T >= 80 && T <= 112)
      HI -= ((13.0 - R) / 4.0) * sqrt((17.0 - fabs(T - 95.0)) / 17.0);
    else if (R > 85 && T >= 80 && T <= 87)
      HI += ((R - 85.0) / 10.0) * ((87.0 - T) / 5.0);
  }
  return (HI - 32.0) / 1.8;                   // -> 섭씨
}

// 화면 고정 요소
void drawFrame() {
  tft.fillScreen(TFT_BLACK);
  int cx = tft.width() / 2;

  if (!ZONE.length()) {                       // 미등록 -> 등록 안내 화면
    tft.setTextDatum(MC_DATUM);
    tft.setTextColor(TFT_ORANGE, TFT_BLACK);
    tft.drawString("REGISTER MAC", cx, 100, 2);
    tft.drawString(MAC, cx, 128, 2);
    return;
  }

  // 등록됨 -> 3행 라벨 (온도/습도/체감)
  tft.pushImage(cx - LBL_TEMP_W / 2, 14,  LBL_TEMP_W, LBL_TEMP_H, LBL_TEMP);
  tft.pushImage(cx - LBL_HUMI_W / 2, 89,  LBL_HUMI_W, LBL_HUMI_H, LBL_HUMI);
  tft.pushImage(cx - LBL_FEEL_W / 2, 164, LBL_FEEL_W, LBL_FEEL_H, LBL_FEEL);

  // 상단 좌측 식별표시
  tft.setTextDatum(TL_DATUM);
  tft.setTextColor(TFT_YELLOW, TFT_BLACK);
  tft.drawString(DEVICE_ID + " " + ZONE, 3, 2, 1);
}

// 측정값 / 상태등 갱신
void drawValues() {
  int cx = tft.width() / 2;
  if (ZONE.length()) {
    char buf[16];
    tft.setTextDatum(TC_DATUM);
    tft.setTextPadding(tft.width());
    snprintf(buf, sizeof(buf), "%.1f", gTemp);
    tft.setTextColor(TFT_YELLOW, TFT_BLACK); tft.drawString(buf, cx, 40, 7);   // 온도 노랑
    snprintf(buf, sizeof(buf), "%.1f", gHumi);
    tft.setTextColor(TFT_CYAN, TFT_BLACK);   tft.drawString(buf, cx, 115, 7);  // 습도 하늘색
    snprintf(buf, sizeof(buf), "%.1f", gFeel);
    tft.setTextColor(TFT_WHITE, TFT_BLACK);  tft.drawString(buf, cx, 190, 7);  // 체감 흰색
  }
  uint16_t c = (WiFi.status() != WL_CONNECTED) ? TFT_DARKGREY
                                               : (lastSendOK ? TFT_GREEN : TFT_RED);
  tft.fillCircle(tft.width() - 7, 6, 4, c);
}

String kstTimestamp() {
  struct tm ti; if (!getLocalTime(&ti, 500)) return "";
  char ts[32]; strftime(ts, sizeof(ts), "%Y-%m-%dT%H:%M:%S+09:00", &ti);
  return String(ts);
}

// table="env_current"(현황,1분,upsert) / "env_log"(이력,1시간,insert)
bool sendData(const char* table, bool upsert) {
  if (WiFi.status() != WL_CONNECTED) return false;
  String ts = kstTimestamp();
  String body = "{";
  body += "\"device_id\":\"" + DEVICE_ID + "\",";
  body += "\"zone\":\"" + ZONE + "\",";
  body += "\"temperature\":" + String(gTemp, 2) + ",";
  body += "\"humidity\":" + String(gHumi, 2) + ",";
  body += "\"feels_like\":" + String(gFeel, 2);
  if (ts.length()) body += ",\"measured_at\":\"" + ts + "\"";
  body += "}";

  String url = String(SB_REST) + table;
  if (upsert) url += "?on_conflict=device_id";

  WiFiClientSecure client; client.setInsecure();
  HTTPClient https;
  https.setConnectTimeout(5000);
  if (!https.begin(client, url)) return false;
  https.addHeader("apikey", SB_KEY);
  https.addHeader("Authorization", String("Bearer ") + SB_KEY);
  https.addHeader("Content-Type", "application/json");
  https.addHeader("Prefer", upsert ? "resolution=merge-duplicates,return=minimal" : "return=minimal");
  int code = https.POST(body); https.end();
  Serial.printf("[%s] POST -> %d\n", table, code);
  return (code == 200 || code == 201 || code == 204);
}

// 통신 전담 태스크 (코어0) - 화면(코어1)과 분리
void netTask(void* p) {
  // WiFi AP 목록 (검사기 카운터와 동일 + 이 위치 taejin_100)
  wifiMulti.addAP("TAEJIN",      "taejinpress");
  wifiMulti.addAP("taejin-A",    "taejinpress");
  wifiMulti.addAP("taejin_100",  "taejinpress");
  wifiMulti.addAP("Android0031", "");
  wifiMulti.addAP("iptime",      "taejinpress");

  // [진단] 주변 AP 스캔 출력 (타깃 AP가 보이는지/신호세기 확인)
  int n = WiFi.scanNetworks();
  Serial.printf("[WiFi] 스캔 %d개 발견:\n", n);
  for (int i = 0; i < n; i++) {
    String s = WiFi.SSID(i);
    bool tgt = (s == "TAEJIN" || s == "taejin-A" || s == "taejin_100" ||
                s == "iptime" || s == "Android0031");
    Serial.printf("   %-22s RSSI %d %s\n", s.c_str(), WiFi.RSSI(i), tgt ? "<== 대상 AP" : "");
  }

  bool ntpDone = false, wasConn = false;
  unsigned long lastTry = 0, lastLive = 0, lastHist = 0;
  for (;;) {
    if (WiFi.status() != WL_CONNECTED) {
      wasConn = false;
      if (millis() - lastTry > 5000) {
        lastTry = millis();
        Serial.println("[WiFi] 연결 시도...");
        wifiMulti.run(8000);
        if (WiFi.status() != WL_CONNECTED)
          Serial.println("[WiFi] 실패 - 대상 AP 미발견/거리/비번 확인");
      }
    } else {
      if (!wasConn) {
        wasConn = true;
        Serial.printf("[WiFi] 연결됨: %s  RSSI %d  IP %s\n",
          WiFi.SSID().c_str(), WiFi.RSSI(), WiFi.localIP().toString().c_str());
        if (!ntpDone) { configTime(9 * 3600, 0, "pool.ntp.org", "time.google.com"); ntpDone = true; delay(800); }
        lastSendOK = sendData("env_current", true);   // 즉시 현황 1건
        sendData("env_log", false);                    // 즉시 이력 1건
        lastLive = millis(); lastHist = millis();
      }
      if (millis() - lastLive >= LIVE_INTERVAL) { lastLive = millis(); lastSendOK = sendData("env_current", true); }
      if (millis() - lastHist >= HIST_INTERVAL) { lastHist = millis(); sendData("env_log", false); }
    }
    vTaskDelay(200 / portTICK_PERIOD_MS);
  }
}

void setup() {
  Serial.begin(115200); delay(300);

  Wire.begin(SHT_SDA, SHT_SCL);
  if (!sht4.begin()) Serial.println("SHT41 not found - 배선 확인");
  sht4.setPrecision(SHT4X_HIGH_PRECISION);
  sht4.setHeater(SHT4X_NO_HEATER);

  WiFi.mode(WIFI_STA);
  resolveIdentity();
  Serial.printf("MAC: %s  ID: %s  ZONE: %s\n", MAC.c_str(), DEVICE_ID.c_str(), ZONE.c_str());

  tft.init();
  tft.setRotation(0);
  drawFrame();

  // 부팅 즉시 첫 측정값 표시
  { sensors_event_t hh, tt; sht4.getEvent(&hh, &tt);
    gTemp = tt.temperature; gHumi = hh.relative_humidity;
    gFeel = heatIndexC(gTemp, gHumi); drawValues(); }

  xTaskCreatePinnedToCore(netTask, "net", 12288, NULL, 1, NULL, 0);
}

void loop() {
  unsigned long now = millis();
  if (now - lastDisp >= DISP_INTERVAL) {
    lastDisp = now;
    sensors_event_t humidity, temp;
    sht4.getEvent(&humidity, &temp);
    gTemp = temp.temperature;
    gHumi = humidity.relative_humidity;
    gFeel = heatIndexC(gTemp, gHumi);
    drawValues();
  }
}
